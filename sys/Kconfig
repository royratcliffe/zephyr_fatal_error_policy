## sys/Kconfig
```kconfig
# SPDX-License-Identifier: Apache-2.0

menu "Zephyr Fatal Error Policy"

rsource "fatal_error/Kconfig"

endmenu
```

## sys/fatal_error/Kconfig
```kconfig
config SYS_FATAL_ERROR
	bool "System fatal error handlers"
	help
	  Selects system fatal error handlers.

module = SYS_FATAL_ERROR
module-str = system fatal error
source "${ZEPHYR_BASE}/subsys/logging/Kconfig.template.log_config"
```
